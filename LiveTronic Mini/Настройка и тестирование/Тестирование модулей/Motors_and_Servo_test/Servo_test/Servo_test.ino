/*******************************************************************************
Программа для проверки работоспособности сервоприводов на силовых портах D2-D13

Версия платы Livetronic: Mini (Robolight)

Дата редакции: 22-03-2017

Разработчик: Артур Голубцов
*******************************************************************************/

#include <Servo.h>

#define MIN 30       // Минимальный угол поворота
#define MAX 150     // Максимальный угол поворота
#define N 12        // Количество сервоприводов для проверки

Servo servo[N];    // Массив с объектами сервоприводов
int pos = 0;        // Переменная для хранения угла поворота

void setup() {
  pinMode(24, INPUT_PULLUP);            // Подключаем встроенную кнопку к порту 24
  for (int i = 0; i < N; i++) {         // Подключаем сервоприводы к портам подряд, начиная со второго
    servo[i].attach(i+2);
  }
}

void loop() {
  //while(digitalRead(24));               // Ждём нажатия кнопки
  //delay(500);                   
  for (int i = 0; i < N; i++)           // Выставляем все сервоприводы в среднее положение(угол 90 градусов)
    servo[i].write(90);                 // Команда для поворота вала сервопривода в определённый угол (в данном случае - 90 градусов)
  while(digitalRead(24));               // Ждём нажатия кнопки   
  for(pos = MIN; pos <= MAX; pos += 1)  // Вращаем вал сервопривода от угла MIN до угла MAX с шагом 1 градус
  {
    for (int i = 0; i < N; i++)         // Выставляем все сервоприводы в угол 'pos'  
      servo[i].write(pos);            
    delay(15);                          // Ждём 15мс для того, чтобы сервопривод успел занять требуемое положение
  } 
  for(pos = MAX; pos>=MIN; pos-=1)      // Вращаем вал сервопривода от угла MAX до угла MIN с шагом 1 градус
  { 
    for (int i = 0; i < N; i++)         // Выставляем все сервоприводы в угол 'pos'
      servo[i].write(pos);            
    delay(15);                          // Ждём 15мс для того, чтобы сервопривод успел занять требуемое положение
  } 
}
