/*******************************************************************************
Программа для проверки одновременной работы сервоприводов на силовых портах 
D2-D8 и D11-D13 и моторов, подключенных к драйверам с управлением по мощности
на портах D9 и D10.

Версия платы Livetronic: Mega (RoboMega5)

Дата редакции: 22-03-2017

Разработчик: Артур Голубцов
*******************************************************************************/

#include <Servo.h>  // Библиотека для работы с сервоприводами

#define MIN 0       // Минимальный угол поворота
#define MAX 180     // Максимальный угол поворота
#define N 12        // Количество сервоприводов для проверки

#define L 1         // Обозначение левого мотора
#define R 2         // Обозначение правого мотора

Servo servo[12];    // Массив с объектами сервоприводов
int pos = 0;        // Пересенная для хранения угла поворота

int DIR1 = 43;      // Цифровые порты, отвечающие за направление движения
int DIR2 = 47;
int PWM1 = 9;       // ШИМ порты, отвечающие за скорость вращения мотора
int PWM2 = 10;
int EN1 = 42;       // Цифровые порты включения/выключения драйверов двигателей
int EN2 = 48;

// Функция установки скорости на левый (L) или правый (R) мотор
// Диапазон допустимых значений скорости Speed [-255; 255]
void SetSpeed(int Motor, int Speed) {
  int DIR, PWM;
  if (Motor == L) {DIR = DIR1; PWM = PWM1;}
  if (Motor == R) {DIR = DIR2; PWM = PWM2;}
  analogWrite(PWM, abs(Speed));
  if ((Speed < -255)||(Speed > 255)) return;
  else if (Speed < 0) digitalWrite(DIR, 0);
  else if (Speed >= 0) digitalWrite(DIR, 1);
}

void setup() {
  for (int i = 0; i < N; i++) {
    if ((i+2 != PWM1)&&(i+2 != PWM2))
      servo[i].attach(i+2);
  }
  pinMode(24, INPUT_PULLUP);  // Устанавливаем кнопку D24 в режим ввода с подтягивающим резистором
  pinMode(EN1, OUTPUT);       // Устанавливаем порты драйвера в режим вывода
  pinMode(EN2, OUTPUT);
  pinMode (PWM1, OUTPUT);
  pinMode (DIR1, OUTPUT);
  pinMode (PWM2, OUTPUT);
  pinMode (DIR2, OUTPUT);
  digitalWrite(EN1, 1);       // Включаем драйвер
  digitalWrite(EN2, 1);
  // Выдаём на моторы неполную мощность для проверки совместной генерации ШИМ и работы библиотеки сервоприводов
  SetSpeed(L, 100);           
  SetSpeed(R, 100);
}

void loop() {                  
  for(pos = MIN; pos <= MAX; pos += 1)  // Вращаем вал сервопривода от угла MIN до угла MAX с шагом 1 градус
  {
    for (int i = 0; i < N; i++)         // Выставляем все сервоприводы в угол 'pos'  
      servo[i].write(pos);            
    delay(15);                          // Ждём 15мс для того, чтобы сервопривод успел занять требуемое положение
  } 
  for(pos = MAX; pos>=MIN; pos-=1)      // Вращаем вал сервопривода от угла MAX до угла MIN с шагом 1 градус
  { 
    for (int i = 0; i < N; i++)         // Выставляем все сервоприводы в угол 'pos'
      servo[i].write(pos);            
    delay(15);                          // Ждём 15мс для того, чтобы сервопривод успел занять требуемое положение
  } 
}
